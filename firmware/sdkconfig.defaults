## firmware/sdkconfig.defaults
```kconfig
CONFIG_FREERTOS_HZ=1000

CONFIG_LOG_DEFAULT_LEVEL_INFO=y

# NanoC6 has no UART pins exposed by default; route the ESP-IDF console
# (logs, esp_log) to the built-in USB-Serial-JTAG so espflash monitor sees it.
CONFIG_ESP_CONSOLE_USB_SERIAL_JTAG=y
CONFIG_ESP_CONSOLE_SECONDARY_NONE=y

CONFIG_ESP32_WIFI_STATIC_RX_BUFFER_NUM=10
CONFIG_ESP32_WIFI_DYNAMIC_RX_BUFFER_NUM=32
CONFIG_ESP32_WIFI_RX_BA_WIN=16

CONFIG_LWIP_TCP_RECVMBOX_SIZE=64
CONFIG_LWIP_TCPIP_RECVMBOX_SIZE=64
```
